## boards/mcxn947-breakout/board.yml
```yaml
board:
  name: mcxn947_breakoutcard
  full_name: Oresat MCXN947 Breakout
  vendor: nxp
  socs:
    - name: mcxn947
```

## boards/mcxn947_mag_card/board.yml
```yaml
board:
  name: mcxn947_mag_card
  vendor: PSAS
  socs:
    - name: mcxn947
  revision:
    format: major.minor.patch
    default: "1.0.0"
    revisions:
    - name: "1.0.0"
    - name: "1.1.0"
```
