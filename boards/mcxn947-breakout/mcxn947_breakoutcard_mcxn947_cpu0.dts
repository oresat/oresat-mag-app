
/dts-v1/;

#include "mcxn947_breakoutcard_mcxn947_cpu0.dtsi"
#include "mcxn947_breakoutcard-pinctrl.dtsi"
#include "mcxn947_breakoutcard.dtsi"

/ {
	model = "NXP MCXN947 Breakoutcard";
	compatible = "nxp,mcxn947", "nxp,mcx";
};
